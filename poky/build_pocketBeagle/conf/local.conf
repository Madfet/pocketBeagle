## poky/build_pocketBeagle/conf/local.conf
```bitbake
MACHINE ?= "pocketbeagle"
DISTRO ?= "poky"
DISTRO_FEATURES:remove = "bluetooth \
                          alsa \
                          ipv6 \ 
                          pcmcia \
                          wifi \
                          xattr \
                          nfs \
                          pci \
                          3g \
                          x11 \
                          seccomp \
                          opengl \
                          multiarch \
                          wayland \
                          vulkan \
                          pulseaudio \
                         "

INIT_MANAGER = "systemd"

PACKAGE_CLASSES ?= "package_rpm"
EXTRA_IMAGE_FEATURES ?= "debug-tweaks"
USER_CLASSES ?= "buildstats"
PATCHRESOLVE = "noop"

BB_DISKMON_DIRS ??= "\
    STOPTASKS,${TMPDIR},1G,100K \
    STOPTASKS,${DL_DIR},1G,100K \
    STOPTASKS,${SSTATE_DIR},1G,100K \
    STOPTASKS,/tmp,100M,100K \
    HALT,${TMPDIR},100M,1K \
    HALT,${DL_DIR},100M,1K \
    HALT,${SSTATE_DIR},100M,1K \
    HALT,/tmp,10M,1K"

hostname_pn-base-files = "PocketBeagle"

CONF_VERSION = "2"
```
